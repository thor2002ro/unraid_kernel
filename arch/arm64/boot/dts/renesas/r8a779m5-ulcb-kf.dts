// SPDX-License-Identifier: (GPL-2.0 or MIT)
/*
 * Device Tree Source for the M3NULCB Kingfisher board with R-Car M3Ne-2G
 *
 * Copyright (C) 2021 Glider bv
 *
 * Based on r8a77965-ulcb-kf.dts
 * Copyright (C) 2018 Renesas Electronics Corp.
 * Copyright (C) 2018 Cogent Embedded, Inc.
 */

#include "r8a779m5-ulcb.dts"
#include "ulcb-kf.dtsi"

/ {
	model = "Renesas M3NULCB Kingfisher board based on r8a779m5";
	compatible = "shimafuji,kingfisher", "renesas,m3nulcb",
		     "renesas,r8a779m5", "renesas,r8a77965";
};
