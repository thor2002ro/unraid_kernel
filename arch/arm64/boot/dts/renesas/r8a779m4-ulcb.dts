// SPDX-License-Identifier: (GPL-2.0 or MIT)
/*
 * Device Tree Source for the M3NULCB (R-Car Starter Kit Pro) with R-Car M3Ne
 *
 * Copyright (C) 2021 Glider bv
 *
 * Based on r8a77965-ulcb.dts
 * Copyright (C) 2018 Renesas Electronics Corp.
 * Copyright (C) 2018 Cogent Embedded, Inc.
 */

/dts-v1/;
#include "r8a779m4.dtsi"
#include "ulcb.dtsi"

/ {
	model = "Renesas M3NULCB board based on r8a779m4";
	compatible = "renesas,m3nulcb", "renesas,r8a779m4", "renesas,r8a77965";

	memory@48000000 {
		device_type = "memory";
		/* first 128MB is reserved for secure area. */
		reg = <0x0 0x48000000 0x0 0x78000000>;
	};
};

&du {
	clocks = <&cpg CPG_MOD 724>,
		 <&cpg CPG_MOD 723>,
		 <&cpg CPG_MOD 721>,
		 <&versaclock5 1>,
		 <&versaclock5 3>,
		 <&versaclock5 2>;
	clock-names = "du.0", "du.1", "du.3",
		      "dclkin.0", "dclkin.1", "dclkin.3";
};
