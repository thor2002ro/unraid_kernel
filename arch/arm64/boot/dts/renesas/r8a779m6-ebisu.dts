// SPDX-License-Identifier: (GPL-2.0 or MIT)
/*
 * Device Tree Source for the Ebisu board with R-Car E3e
 *
 * Copyright (C) 2021 Glider bv
 *
 * Based on r8a77990-ebisu.dts
 * Copyright (C) 2018 Renesas Electronics Corp.
 */

/dts-v1/;
#include "r8a779m6.dtsi"
#include "ebisu.dtsi"

/ {
	model = "Renesas Ebisu board based on r8a779m6";
	compatible = "renesas,ebisu", "renesas,r8a779m6", "renesas,r8a77990";
};
