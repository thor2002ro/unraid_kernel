// SPDX-License-Identifier: (GPL-2.0+ OR MIT)
/*
 * Google Lazor board device tree source
 *
 * Copyright 2020 Google LLC.
 */

/dts-v1/;

#include "sc7180-trogdor-lazor.dtsi"

/ {
	model = "Google Lazor (rev1 - 2)";
	compatible = "google,lazor-rev1", "google,lazor-rev2", "qcom,sc7180";
};

&usb_hub_2_0 {
	 vdd-supply = <&pp3300_l7c>;
};

&usb_hub_3_0 {
	 vdd-supply = <&pp3300_l7c>;
};
