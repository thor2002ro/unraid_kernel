## Documentation/devicetree/bindings/phy/aspeed,ast2600-pcie-phy.yaml
```yaml
# SPDX-License-Identifier: (GPL-2.0-only OR BSD-2-Clause)
%YAML 1.2
---
$id: http://devicetree.org/schemas/phy/aspeed,ast2600-pcie-phy.yaml#
$schema: http://devicetree.org/meta-schemas/core.yaml#

title: ASPEED PCIe PHY

maintainers:
  - Jacky Chou <jacky_chou@aspeedtech.com>

description:
  The ASPEED PCIe PHY provides the physical layer functionality for PCIe
  controllers in the SoC.

properties:
  compatible:
    items:
      - enum:
          - aspeed,ast2600-pcie-phy
          - aspeed,ast2700-pcie-phy

  reg:
    maxItems: 1

  "#phy-cells":
    const: 0

required:
  - compatible
  - reg
  - "#phy-cells"

additionalProperties: false

examples:
  - |
    phy@1e6ed200 {
      compatible = "aspeed,ast2600-pcie-phy";
      reg = <0x1e6ed200 0x100>;
      #phy-cells = <0>;
    };
```

## drivers/phy/aspeed/Kconfig
```kconfig
# SPDX-License-Identifier: GPL-2.0-only
#
# Phy drivers for Aspeed platforms
#
config PHY_ASPEED_PCIE
	tristate "ASPEED PCIe PHY driver"
	select GENERIC_PHY
	depends on ARCH_ASPEED
	default y
	help
	  This option enables support for the ASPEED PCIe PHY driver.
	  The driver provides the necessary interface to control and
	  configure the PCIe PHY hardware found on ASPEED SoCs.
	  It is required for proper operation of PCIe devices on
	  platforms using ASPEED chips.
```
