## Documentation/devicetree/bindings/ipmi/ipmi-ipmb.yaml
```yaml
# SPDX-License-Identifier: (GPL-2.0-only OR BSD-2-Clause)
%YAML 1.2
---
$id: http://devicetree.org/schemas/ipmi/ipmi-ipmb.yaml#
$schema: http://devicetree.org/meta-schemas/core.yaml#

title: IPMI IPMB device bindings

description: IPMI IPMB device bindings

maintainers:
  - Corey Minyard <cminyard@mvista.com>

properties:
  compatible:
    enum:
      - ipmi-ipmb

  device_type:
    items:
      - const: "ipmi"

  reg:
    maxItems: 1

  bmcaddr:
    description: The address of the BMC on the IPMB bus.
    maxItems: 1

  retry-time-ms:
    description: Time between retries of sends, in milliseconds.
    maxItems: 1

  max-retries:
    description: Number of retries before a failure is declared.
    maxItems: 1

required:
  - compatible
  - reg

additionalProperties: false

examples:
  - |
    ipmi-ipmb@0x40 {
        compatible = "ipmi-ipmb";
        device_type = "ipmi";
        reg = <0x40>;
        bmcaddr = /bits/ 8 <0x20>;
        retry-time-ms = <250>;
        max-retries = <1>;
    };
```

## Documentation/devicetree/bindings/mfd/sprd,ums512-glbreg.yaml
```yaml
# SPDX-License-Identifier: (GPL-2.0-only OR BSD-2-Clause)
%YAML 1.2
---
$id: http://devicetree.org/schemas/mfd/sprd,ums512-glbreg.yaml#
$schema: http://devicetree.org/meta-schemas/core.yaml#

title: Unisoc System Global Register Device Tree Bindings

maintainers:
  - Orson Zhai <orsonzhai@gmail.com>
  - Baolin Wang <baolin.wang7@gmail.com>
  - Chunyan Zhang <zhang.lyra@gmail.com>

description:
  Unisoc system global registers provide register map
  for clocks and some multimedia modules of the SoC.

properties:
  "#address-cells": true
  "#size-cells": true

  compatible:
    items:
      - const: sprd,ums512-glbregs
      - const: syscon
      - const: simple-mfd

  ranges:
    maxItems: 1

  reg:
    maxItems: 1

patternProperties:
  "^.*@[0-9a-f]+$":
    # Child node
    type: object
    $ref: "../clock/sprd,ums512-clk.yaml"
    description:
      Clock controller for the SoC clocks.

required:
  - compatible
  - reg

additionalProperties: false

examples:
  - |
    ap_apb_regs: syscon@71000000 {
      compatible = "sprd,ums512-glbregs", "syscon", "simple-mfd";
      reg = <0x71000000 0x3000>;
      #address-cells = <1>;
      #size-cells = <1>;
      ranges = <0 0x71000000 0x3000>;

      clock-controller@0 {
        compatible = "sprd,ums512-apahb-gate";
        reg = <0x0 0x2000>;
        #clock-cells = <1>;
      };
    };

  - |
    ap_intc5_regs: syscon@32360000 {
      compatible = "sprd,ums512-glbregs", "syscon", "simple-mfd";
      reg = <0x32360000 0x1000>;
    };
```

## drivers/hid/lenovo-legos-hid/Kconfig
```kconfig
config LENOVO_LEGOS_HID
	tristate "Lenovo Legion Go S HID"
	depends on USB_HID
	depends on LEDS_CLASS
	depends on LEDS_CLASS_MULTICOLOR
	help
	  Say Y here to include support for the Lenovo Legion Go S Handheld
	  Console Controller.

	  To compile this driver as a module, choose M here: the module will
	  be called lenovo-legos-hid.
```

## drivers/hid/zotac-zone-hid/Kconfig
```kconfig
config ZOTAC_ZONE_HID
	tristate "Zotac Zone handheld support"
	depends on USB_HID
	depends on LEDS_CLASS
	depends on LEDS_CLASS_MULTICOLOR
	select POWER_SUPPLY
	help
	Support for the Zotac Zone handheld gaming console.
```

## drivers/infiniband/hw/mana/Kconfig
```kconfig
# SPDX-License-Identifier: GPL-2.0-only
config MANA_INFINIBAND
	tristate "Microsoft Azure Network Adapter support"
	depends on NETDEVICES && ETHERNET && PCI && MICROSOFT_MANA
	help
	  This driver provides low-level RDMA support for
	  Microsoft Azure Network Adapter (MANA).
```
